## driver/Kconfig
```kconfig
menu "Hardware Drivers Config"

    menuconfig BSP_USING_UART
        bool "Using UART"
        select RT_USING_SERIAL
        default y

        if BSP_USING_UART
            config RT_USING_UART0
                bool "Enable UART 0"
                default y

            config RT_USING_UART1
                bool "Enable UART 1"
                default n

            config RT_USING_UART2
                bool "Enable UART 2"
                default n

            config RT_USING_UART3
                bool "Enable UART 3"
                default n

            config RT_USING_UART4
                bool "Enable UART 4"
                default n

            config RT_USING_UART5
                bool "Enable UART 5"
                default n

            config RT_USING_UART6
                bool "Enable UART 6"
                default n

            config RT_USING_UART7
                bool "Enable UART 7"
                default n

            config RT_USING_UART8
                bool "Enable UART 8"
                default n

            config RT_USING_UART9
                bool "Enable UART 9"
                default n
        endif

    config BSP_USING_GIC
        bool
        default y

        config BSP_USING_GICV2
            bool
            default y

    config BSP_USING_CLK
        bool "Using CLK (Clock Driver)"
        default y
        help
            Enable RK3576 clock driver for inspecting and configuring
            clock frequencies. Provides MSH commands: clk_list,
            clk_rate, clk_dump, clk_set, clk_enable, clk_disable.

endmenu
```
